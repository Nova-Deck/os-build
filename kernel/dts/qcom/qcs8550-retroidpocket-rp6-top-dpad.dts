// SPDX-License-Identifier: BSD-3-Clause
/*
 * Copyright (c) 2026, Nova-Deck.
 */

/dts-v1/;

#include "qcs8550-retroidpocket-rp6.dts"

/ {
	model = "Retroid Pocket 6 TOP-DPAD";
};

&gamepad {
    invert-x;
    invert-y;
};
